# register_block: IP-XACT component
VLNV example.com:ip_examples:register_block:1.0

## Address spaces and blocks
control_registers.reg_block_0: base 0x0000, range 0x1000, width 32

## Registers
Registers are 32-bit, read-write, reset 0xDEADBEEF unless marked. A register's access mark holds for its fields unless they carry their own. Offsets are from the block's base; lines under a group give offsets from that group; [hi:lo] are bit positions; {n}, {i} and the like mark numbered series; 'fields as' and 'values as' point back to an identical list; <NAME> marks a mode.

## control_registers.reg_block_0
Base 0x00000000
0x00 RW_REG — Read-Write Register
  [31:0] RW_FIELD
0x04 RO_REG ro reset 0x12345678 — Read-Only Register
  [31:0] RO_FIELD
0x08 WO_REG wo reset 0xAAAA5555 — Write-Only Register
  [31:0] WO_FIELD
0x0C RC_REG ro reset 0xF0F0F0F0 — Read-Clear Register
  [31:0] RC_FIELD read-clears
0x10 W1C_REG reset 0x55AA55AA — Write-1-to-Clear Register
  [31:0] W1C_FIELD write-1-clears
0x14 W1S_REG reset 0x33CC33CC — Write-1-to-Set Register
  [31:0] W1S_FIELD write-1-sets
0x18 WOC_REG wo reset 0x99669966 — Write-Only-Clear Register
  [31:0] WOC_FIELD write-clears

# ?: IP-XACT component
VLNV :::

## Address spaces and blocks
complete_register_map.control_block: base 0x0000, range 0x1000, width 32, register

## Registers
Registers are 32-bit, read-write, reset 0x12345678 unless marked. A register's access mark holds for its fields unless they carry their own. Offsets are from the block's base; lines under a group give offsets from that group; [hi:lo] are bit positions; {n}, {i} and the like mark numbered series; 'fields as' and 'values as' point back to an identical list; <NAME> marks a mode.

## complete_register_map.control_block
Base 0x00000000
{0x0+4i} COMPLETE_REG[{i}] (i=0..3) — Register demonstrating all possible attributes
0x00 RW_REG reset 0xDEADBEEF
0x04 RO_REG ro
0x08 WO_REG wo reset 0x0
0x0C RW1_REG rw-once reset 0xAAAA5555
0x10 RC_REG read-clear reset 0xFFFF0000
0x14 W1_REG write-once reset 0xFF00FF
0x18 RWC_REG read-writeOnce-clear reset 0x55AA55AA

# register_map: IP-XACT component
VLNV example.com:registers:register_map:1.0

## Address spaces and blocks
SVDB_complete_register_map.main_block: base 0x0000, range 0x1000, width 32, register

## Registers
Registers are 32-bit, read-write, reset 0x0 unless marked. A register's access mark holds for its fields unless they carry their own. Offsets are from the block's base; lines under a group give offsets from that group; [hi:lo] are bit positions; {n}, {i} and the like mark numbered series; 'fields as' and 'values as' point back to an identical list; <NAME> marks a mode.

## SVDB_complete_register_map.main_block
Base 0x00000000
0x00 SVDB_COMPLETE_REG — Complete register containing all status information
0x04 SVDB_RW_REG — Read-write register with multiple access types
0x08 SVDB_RO_REG ro — Read-only register for status monitoring
0x0C SVDB_WO_REG wo — Write-only register for control operations
0x10 SVDB_RW1_REG write-once — Write-once register for configuration
0x14 SVDB_RC_REG ro — Read-clear register that clears on read
0x18 SVDB_W1_REG — Write-1-to-clear register for status clearing operations
0x1C SVDB_RWC_REG — Read-write-clear register with clear on write functionality
0x20 SVDB_READ_CLEAR_REG ro — Register that automatically clears its contents after being read
0x24 SVDB_READ_ACTIONS_REG ro — Register demonstrating different read action behaviors (clear, set, modify)
0x28 SVDB_WRITE_ACTIONS_REG — Register demonstrating different write action behaviors (clear, set, toggle)
